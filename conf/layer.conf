## conf/layer.conf
```bitbake
# We might have a conf and classes directory, append to BBPATH
BBPATH .= ":${LAYERDIR}"

# We have recipes directories, add to BBFILES
BBFILES += "${LAYERDIR}/recipes*/*/*.bb \
            ${LAYERDIR}/recipes*/*/*.bbappend"

BBFILE_COLLECTIONS += "meta-progra"
BBFILE_PATTERN_meta-progra := "^${LAYERDIR}/"
BBFILE_PRIORITY_meta-progra = "5"

# This should only be incremented on significant changes that will
# cause compatibility issues with other layers
LAYERVERSION_meta-progra = "1.0"

#LAYERDEPENDS_meta-progra = "core openembedded-layer"

LAYERSERIES_COMPAT_meta-progra = "warrior"

LICENSE_PATH += "${LAYERDIR}/licenses"
```
